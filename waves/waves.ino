int wave [24] [14]{
{1, 1, 0, 0, 0, 0, 0, 0, 0, 0, 0, 0, 0, 0},
{0, 1, 1, 0, 0, 0, 0, 0, 0, 0, 0, 0, 0, 0},
{0, 0, 1, 1, 0, 0, 0, 0, 0, 0, 0, 0, 0, 0},
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{0, 1, 1, 0, 0, 0, 0, 0, 0, 0, 0, 0, 0, 0}
};
void setup() {
  // put your setup code here, to run once:
for (int j = 2; j <= 15; j++) {
    pinMode(j,OUTPUT);
  };
}

void loop() {
  // put your main code here, to run repeatedly:
    for (int k = 5 ; k <= 5 ; k++){
      for (int i = 23 ; i > -1 ; i = i-1 ) {
   
    digitalWrite(2,abs(wave[i][13-1]));
    digitalWrite(3,abs(wave[i][12-1]));
    digitalWrite(4,abs(wave[i][11-1]));
    digitalWrite(5,abs(wave[i][10-1]));
    digitalWrite(6,abs(wave[i][9-1]));
    digitalWrite(7,abs(wave[i][8-1]));
    digitalWrite(8,abs(wave[i][7-1]));
    digitalWrite(9,abs(wave[i][6-1]));
    digitalWrite(10,abs(wave[i][5-1]));
    digitalWrite(11,abs(wave[i][4-1]));
    digitalWrite(12,abs(wave[i][3-1]));
    digitalWrite(13,abs(wave[i][2-1]));
    digitalWrite(14,abs(wave[i][1-1]));
    digitalWrite(15,abs(wave[i][14-1]));
    delay(55);
    };
};

}
